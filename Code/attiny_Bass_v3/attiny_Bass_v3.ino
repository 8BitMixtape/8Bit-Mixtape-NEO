// ######################## Clock 16 Mhz intern ############################################

#include <avr/pgmspace.h>
#include "neolib.h"

uint8_t sync = 0;
uint8_t wave = 1;

bool full = true;

uint8_t uSteps = 192;                                // microsteps in one octave
unsigned int Acc = 255;
unsigned int Acc2 = 255;
//const uint8_t vol = 255;
unsigned int note = 214;
unsigned int baseNote = 288;
unsigned int note2, type;
bool gateOpen;

//


const unsigned int tunes1345steps[] PROGMEM = {
  54, 54, 54, 54, 54, 55, 55, 55, 55, 55, 56, 56, 56, 56, 56, 57,   // tempered 12 tune steps on left column
  57, 57, 57, 57, 58, 58, 58, 58, 58, 59, 59, 59, 59, 59, 60, 60,    // others are used as microsteps for detune
  60, 60, 61, 61, 61, 61, 61, 62, 62, 62, 62, 63, 63, 63, 63, 63,
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  6473, 6497, 6520, 6544, 6568, 6591, 6615, 6639, 6663, 6687, 6711, 6736, 6760, 6784, 6809, 6834,
  6858
};

const byte sine256[] PROGMEM = { // sine wavetable
  0, 0, 0, 0, 0, 0, 1, 1, 1, 2, 2, 3,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 128,
  128, 131, 134, 137, 140, 143, 146, 149, 152, 155, 158, 162,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 246,
  248, 249, 250, 250, 251, 252, 253, 253, 254, 254, 254, 255,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 211,
  208, 206, 203, 201, 198, 196, 193, 190, 188, 185, 182, 179,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 65,
  62, 59, 57, 54, 52, 49, 47, 44, 42, 40, 37, 35, 33, 31, 29, 27, 25, 23, 21, 20, 18, 17, 15, 14, 12, 11, 10, 9, 7, 6, 5, 5, 4, 3, 2, 2, 1, 1, 1, 0
};

void setup() {
  
  OSCCAL += 3;                            // Oscillator calibration

  // Enable 64 MHz PLL and use as source for Timer1
  PLLCSR = 1 << PCKE | 1 << PLLE;

  // Set up Timer/Counter1 for PWM output
  TIMSK = 0;                                          // Timer interrupts OFF
  TCCR1 = 1 << PWM1A | 2 << COM1A0 | 1 << CS10;       // PWM OCR1A, clear on match, 1:1 prescale
  pinMode(1, OUTPUT);                                 // Enable PWM output pin

  // Set up Timer/Counter0 for interrupt to output samples.
  TCCR0A = 3 << WGM00;                                // Fast PWM
  TCCR0B = 1 << WGM02 | 2 << CS00;                    // 1/8 prescale
  TIMSK = 1 << OCIE0A;                                // Enable compare match, disable overflow
  OCR0A = 199;                                         // Divide by 400
  pinMode(0, OUTPUT);
  neobegin();
  //setColorAllPixel(colorWheel(220));
  //pixels.show();
}

void loop() {
    
  uint8_t b = wasButtonPressed();
  
  if( b == BUTTON_LEFT                )   type--   ;
  if( b == BUTTON_RIGHT               )   type++   ;  

  type   &= 0b00000011; // prevent out of range

  gateOpen = 1;
  int16_t lp = getPoti( POTI_RIGHT );   // range 0..1023
  int16_t rp = getPoti( POTI_LEFT );    // range 0..255

  //setColorAllPixel(colorWheel(220));
  //pixels.setPixelColor( 2, COLOR_GREEN );
  //pixels.show();

  baseNote = (map(lp, 0, 1023, 12, 72) << 4) + uSteps;
  note = pgm_read_word(&tunes1345steps[baseNote]);

  int detune = map(rp, 1023, 0, 0, uSteps);
  if (detune == 0) {
    note2 = note >> 1;
  } else {
    note2 = pgm_read_word(&tunes1345steps[baseNote + detune - uSteps]);
  }

}


ISR(TIMER0_COMPA_vect) {

  if (gateOpen) {
 
    Acc = Acc + note;
    Acc2 = Acc2 + note2;


    switch (type) {

      case 0:                                         // Square

        int temp, temp2;
        OCR1A = ((((Acc >> 8) & 0x80) + ((Acc2 >> 8) & 0x80)) * 100) >> 8;
        break;

      case 1:                                         // Ramp Up

        OCR1A = (((Acc >> 9) + (Acc2 >> 9)) * 130) >> 8;
        break;

      case 2:                                         // Triangle

        signed char Temp, Mask, Temp2, Mask2;
        Temp = Acc >> 8;
        Mask = Temp >> 7;
        Temp2 = Acc2 >> 8;
        Mask2 = Temp2 >> 7;
        OCR1A = (((Temp ^ Mask) + (Temp2 ^ Mask2)) * 210) >> 8 ;
        break;

      case 3:                                         // Sinus

        OCR1A = (((pgm_read_byte(&sine256[Acc >> 8]) + pgm_read_byte(&sine256[Acc2 >> 8])) >> 1) * 255) >> 8;
        break;

    }
  }
}
